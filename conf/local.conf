## conf/local.conf
```bitbake
# Copyright 2021 HM Revenue & Customs
#
# Licensed under the Apache License, Version 2.0 (the "License");
# you may not use this file except in compliance with the License.
# You may obtain a copy of the License at
#
#     http://www.apache.org/licenses/LICENSE-2.0
#
# Unless required by applicable law or agreed to in writing, software
# distributed under the License is distributed on an "AS IS" BASIS,
# WITHOUT WARRANTIES OR CONDITIONS OF ANY KIND, either express or implied.
# See the License for the specific language governing permissions and
# limitations under the License.

include "application.conf"

play.filters.cors.allowedOrigins = null
play.filters.csp {
    directives {
      default-src = "'self' 'unsafe-inline' 'unsafe-eval' http://localhost:9032 http://localhost:12345 www.googletagmanager.com www.google-analytics.com cdnjs.cloudflare.com www.gstatic.com fonts.googleapis.com fonts.gstatic.com data:"
    }
}
```
